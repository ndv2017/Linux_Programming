## 10__GPIO_Legacy/mgpio_legacy/Kconfig
```kconfig
menu "mgpio legacy device driver"

config MGPIO_LEGACY
    tristate "mgpio legacy device driver"
    depends on ARM
    default y if ARM
    help
        Select this option to run mgpio legacy module.
        If unsure, choose 'y' for built-in, 'm' for module, or 'n' for no support.
endmenu
```

## 11__GPIO_Integer_Based/mgpio_integer_based/Kconfig
```kconfig
menu "mgpio integer-based device driver"

config MGPIO_INTEGER_BASED
    tristate "mgpio integer-based device driver"
    depends on ARM
    default y if ARM
    help
        Select this option to run mgpio integer-based module.
        If unsure, choose 'y' for built-in, 'm' for module, or 'n' for no support.
endmenu
```

## 12__GPIO_Descriptor_Based/mgpio_descriptor_based/Kconfig
```kconfig
menu "mgpio descriptor-based device driver"

config MGPIO_DESCRIPTOR_BASED
    tristate "mgpio descriptor-based device driver"
    depends on ARM
    default y if ARM
    help
        Select this option to run mgpio descriptor-based module.
        If unsure, choose 'y' for built-in, 'm' for module, or 'n' for no support.
endmenu
```
